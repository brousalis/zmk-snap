## config/west.yml
```yaml
manifest:
  remotes:
    - name: brousalis
      url-base: https://github.com/brousalis
  projects:
    - name: zmk
      remote: brousalis
      revision: main
      import: app/west.yml
  self:
    path: config
```
